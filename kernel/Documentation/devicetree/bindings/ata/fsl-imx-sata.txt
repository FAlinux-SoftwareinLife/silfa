## kernel/Documentation/devicetree/bindings/ata/fsl-imx-sata.txt
```
* Freescale imx AHCI 1.5/3.0 Gb/s SATA nodes

AHCI SATA nodes are defined to describe on-chip Serial ATA controllers.

Required properties:
- compatible        : compatible list, contains 1 entries, first is
		 "fsl,CHIP-ahci", where CHIP is the processor
		 (imx6q, etc.).
- reg               : <registers mapping>
- interrupts        : <interrupt mapping for SATA IRQ>

Example:
	ahci@0x02200000 { /* AHCI SATA */
		compatible = "fsl,imx6q-ahci";
		reg = <0x02200000 0x4000>;
		interrupts = <0 39 0x04>;
		status = "disabled";
	};
```
